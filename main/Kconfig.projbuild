## main/Kconfig.projbuild
```kconfig
menu "ESP32 NanoBot Configuration"

    menu "AI Provider Settings"
        config AI_PROVIDER_API_KEY
            string "AI Provider API Key"
            default ""
            help
                API key for the AI provider (DeepSeek, Moonshot, etc.)

        config AI_PROVIDER_MODEL
            string "AI Model Name"
            default "deepseek-chat"
            help
                Model name to use for AI completions

        config AI_PROVIDER_TYPE
            string "Provider Type"
            default "deepseek"
            help
                Select AI provider type (deepseek, moonshot, dashscope, etc.)

        config AI_PROVIDER_BASE_URL
            string "Provider Base URL"
            default "https://api.deepseek.com"
            help
                Base URL for the AI provider API
    endmenu

    menu "QQ Bot Settings"
        config QQ_BOT_ENABLED
            bool "Enable QQ Bot"
            default y
            help
                Enable QQ bot integration

        config QQ_APP_ID
            string "QQ App ID"
            default ""
            help
                QQ Open Platform App ID

        config QQ_APP_SECRET
            string "QQ App Secret"
            default ""
            help
                QQ Open Platform App Secret
    endmenu

    menu "Feishu Bot Settings"
        config FEISHU_BOT_ENABLED
            bool "Enable Feishu Bot"
            default y
            help
                Enable Feishu (飞书) bot integration

        config FEISHU_APP_ID
            string "Feishu App ID"
            default ""
            help
                Feishu Open Platform App ID

        config FEISHU_APP_SECRET
            string "Feishu App Secret"
            default ""
            help
                Feishu Open Platform App Secret
    endmenu

    menu "Daily Summary Skill"
        config GIT_REPO_PATH
            string "Git Repository Path"
            default "/sd/git"
            help
                Path to the git repository on SD card

        config SUMMARY_SEND_TIME
            string "Daily Summary Send Time (HH:MM)"
            default "18:00"
            help
                Time to send daily summary (24-hour format)
    endmenu

    menu "Network Settings"
        config WIFI_SSID
            string "WiFi SSID"
            default ""
            help
                WiFi network name

        config WIFI_PASSWORD
            string "WiFi Password"
            default ""
            help
                WiFi password

        config USE_STATIC_IP
            bool "Use Static IP"
            default n
            help
                Use static IP address instead of DHCP

        config STATIC_IP_ADDRESS
            string "Static IP Address"
            default "192.168.1.100"
            help
                Static IP address

        config STATIC_GATEWAY
            string "Default Gateway"
            default "192.168.1.1"
            help
                Default gateway address
    endmenu

endmenu
```

## sdkconfig.defaults
```kconfig
# ESP32 NanoBot SDK Configuration

CONFIG_ESP32S3_DEFAULT_CPU_FREQ_240=y
CONFIG_ESP32S3_DATA_CACHE_64KB=y
CONFIG_ESP32S3_DATA_CACHE_LINE_64B=y

# Flash configuration (16MB)
CONFIG_ESPTOOLPY_FLASHSIZE_16MB=y
CONFIG_PARTITION_TABLE_TWO_OTA=y

# PSRAM configuration (8MB Octal)
CONFIG_SPIRAM=y
CONFIG_SPIRAM_TYPE_QUAD=y
CONFIG_SPIRAM_SIZE_8MB=y
CONFIG_SPIRAM_MODE_OCT=y
CONFIG_SPIRAM_SPEED_80M=y
CONFIG_SPIRAM_CACHE_WORKAROUND=y
CONFIG_SPIRAM_USE_MALLOC=y

# Heap memory optimization
CONFIG_HEAP_POISONING_DISABLED=y
CONFIG_HEAP_TRACING_OFF=y

# LwIP optimization
CONFIG_LWIP_SO_REUSE=y
CONFIG_LWIP_SO_RCVBUF=y
CONFIG_LWIP_NETBUF_RECVINFO=y
CONFIG_LWIP_IPV6=n
CONFIG_LWIP_BROADCAST_PING=y
CONFIG_LWIP_MULTICAST_PING=y

# TLS/SSL configuration
CONFIG_MBEDTLS_TLS_SERVER=y
CONFIG_MBEDTLS_TLS_CLIENT=y
CONFIG_MBEDTLS_SSL_PROTO_TLS1_2=y
CONFIG_MBEDTLS_SSL_PROTO_TLS1_3=y
CONFIG_MBEDTLS_AES_C=y
CONFIG_MBEDTLS_GCM_C=y
CONFIG_MBEDTLS_SHA256_C=y
CONFIG_MBEDTLS_ECP_DP_SECP256R1_ENABLED=y
CONFIG_MBEDTLS_ECP_DP_SECP384R1_ENABLED=y
CONFIG_MBEDTLS_ECP_NIST_OPTIM=y
CONFIG_MBEDTLS_MAX_MEMORY_IN_SSL=16384

# HTTP Client
CONFIG_ESP_HTTP_CLIENT_ENABLE_HTTPS=y
CONFIG_ESP_HTTP_CLIENT_ENABLE_BASIC_AUTH=y

# WebSocket
CONFIG_ESP_WS_CLIENT_ENABLED=y

# JSON support
CONFIG_JSON_USE_JSON_EX=y

# FreeRTOS optimization
CONFIG_FREERTOS_HZ=1000
CONFIG_FREERTOS_MAX_TASK_NAME_LEN=32
CONFIG_FREERTOS_MINIMAL_STACK_SIZE=768
CONFIG_FREERTOS_DEFAULT_STACK_SIZE=4096
CONFIG_FREERTOS_CHECK_STACKOVERFLOW_CANARY=y

# Log level
CONFIG_LOG_DEFAULT_LEVEL_INFO=y
CONFIG_LOG_DEFAULT_LEVEL=3

# NVS
CONFIG_NVS_ENCRYPTION=n

# SD/MMC card support
CONFIG_SDMMC_USE_SDIO_EXTENSIONS=y
CONFIG_SDMMC_TASK_PRIORITY=5
CONFIG_SDMMC_STACK_SIZE=4096

# Timer support
CONFIG_TIMER_ENABLED=y

# C++ support
CONFIG_COMPILER_CXX=y
CONFIG_COMPILER_CXX_EXCEPTIONS=y
CONFIG_COMPILER_CXX_RTTI=y

# Main function
CONFIG_MAIN_FUNCTION_IS_CPP=y
```
